## components/camera/Kconfig
```kconfig
menu "Fridge Spirit Camera"

    config FRIDGE_CAMERA_TEST
        bool "Enable OV3660 camera-only test mode"
        default n
        help
            Enable a camera-only bring-up firmware path. This mode starts NVS,
            USB protocol, network/time, AI config and the OV3660 camera, while
            skipping screen, touch, sensors and audio to avoid GPIO conflicts.

    config FRIDGE_CAMERA_XCLK_HZ
        int "OV3660 XCLK frequency"
        default 10000000
        range 5000000 20000000
        help
            Initial bring-up clock. Keep this low until wiring, power and PSRAM
            stability are verified on the real module.

    config FRIDGE_CAMERA_PREVIEW_MAX_BYTES
        int "Maximum JPEG bytes returned as USB preview"
        default 65536
        range 8192 131072
        help
            If the captured JPEG exceeds this size, camera_capture returns an
            error instead of pushing a very large JSON line over Web Serial.

endmenu
```

## components/display_test/Kconfig
```kconfig
menu "Fridge Spirit screen test"

    config FRIDGE_SCREEN_TEST
        bool "Enable standalone QSPI screen test"
        default y
        help
            启用后主程序只运行 TS040HDS02CP-B1620A QSPI 屏幕点亮测试，
            不启动 Wi-Fi 和 USB 业务流程，便于首次接线时降低电源峰值与干扰。

    config FRIDGE_SCREEN_TEST_PCLK_HZ
        int "QSPI screen test clock in Hz"
        depends on FRIDGE_SCREEN_TEST
        default 10000000
        range 1000000 60000000
        help
            屏幕 QSPI 测试时钟。首次松散插线测试建议保持 10 MHz，
            确认供电、排线和 WAIT# 稳定后再逐步提高。

    config FRIDGE_SCREEN_TEST_COLOR_HOLD_MS
        int "Screen test color hold time in ms"
        depends on FRIDGE_SCREEN_TEST
        default 3000
        range 500 60000
        help
            每个全屏色块保持的时间。默认 3 秒用于长时间稳定性观察，
            避免 1 秒循环导致串口日志和主机终端刷新过密。

    config FRIDGE_SCREEN_TEST_REPORT_EVERY_CYCLES
        int "Screen test report interval in color cycles"
        depends on FRIDGE_SCREEN_TEST
        default 10
        range 1 1000
        help
            每完成多少轮白/红/绿/蓝/黑循环后打印一次存活日志。
            默认 10 轮约 150 秒打印一次，适合长时间运行。

    config FRIDGE_SCREEN_TEST_VERBOSE_LOG
        bool "Enable verbose screen test loop logs"
        depends on FRIDGE_SCREEN_TEST
        default n
        help
            启用后会在每个色块、每次 SPI 总线占用和首尾数据块写入时打印详细日志。
            只建议排查点亮失败时开启；长时间测试应保持关闭，避免主机串口终端堆积输出。

endmenu
```

## components/display_test/Kconfig.bak-20260522-152055
```kconfig
menu "Fridge Spirit screen test"

    config FRIDGE_SCREEN_TEST
        bool "Enable standalone QSPI screen test"
        default y
        help
            启用后主程序只运行 TS040HDS02CP-B1620A QSPI 屏幕点亮测试，
            不启动 Wi-Fi 和 USB 业务流程，便于首次接线时降低电源峰值与干扰。

    config FRIDGE_SCREEN_TEST_PCLK_HZ
        int "QSPI screen test clock in Hz"
        depends on FRIDGE_SCREEN_TEST
        default 10000000
        range 1000000 60000000
        help
            屏幕 QSPI 测试时钟。首次松散插线测试建议保持 10 MHz，
            确认供电、排线和 WAIT# 稳定后再逐步提高。

endmenu
```

## components/ui/Kconfig
```kconfig
menu "Fridge Spirit UI"

    config FRIDGE_UI_ENABLE
        bool "Enable LVGL touch UI"
        default y
        help
            启用后正常主控模式会启动 720x720 LVGL 本地触摸 UI。
            首轮 UI 会复用已验证的 TR230S QSPI 显示路径，并保留 USB/Web 面板并行运维。

endmenu
```

## main/Kconfig.projbuild
```kconfig
menu "Fridge Spirit build profile"

config FRIDGE_RECOVERY_APP
    bool "Build small local recovery firmware"
    default n
    help
        构建本地恢复固件。该固件应烧录到 ota_1 小分区，只保留 NVS、
        Wi-Fi、USB JSON Lines 和后续 OTA 恢复入口，不链接屏幕、摄像头、
        AI、语音、雷达和 LVGL 主业务。

endmenu
```

## tmp/backup_ai_api_20260520_221138/sdkconfig.defaults
```kconfig
# ESP32-S3-DevKitC-1 N8R8: 8MB Flash + 8MB PSRAM
CONFIG_IDF_TARGET="esp32s3"
CONFIG_ESPTOOLPY_FLASHSIZE_8MB=y
CONFIG_ESPTOOLPY_FLASHSIZE="8MB"

# 使用自定义 8MB 分区表：双 OTA、LittleFS、本地 coredump。
CONFIG_PARTITION_TABLE_CUSTOM=y
CONFIG_PARTITION_TABLE_CUSTOM_FILENAME="partitions.csv"
CONFIG_PARTITION_TABLE_FILENAME="partitions.csv"

# OTA 回滚：升级失败可回退，适合后续远程运维。
CONFIG_BOOTLOADER_APP_ROLLBACK_ENABLE=y
CONFIG_APP_ROLLBACK_ENABLE=y

# N8R8 模组常见为 8MB Octal PSRAM；保守使用 80MHz，不启用 120MHz 实验频率。
CONFIG_SPIRAM=y
CONFIG_SPIRAM_MODE_OCT=y
CONFIG_SPIRAM_TYPE_ESPPSRAM64=y
CONFIG_SPIRAM_SPEED_80M=y
CONFIG_SPIRAM_USE_MALLOC=y
CONFIG_SPIRAM_MEMTEST=y
CONFIG_SPIRAM_MALLOC_ALWAYSINTERNAL=16384
CONFIG_SPIRAM_MALLOC_RESERVE_INTERNAL=65536
CONFIG_SPIRAM_TRY_ALLOCATE_WIFI_LWIP=y

# 现场调试保留 brownout 和 flash coredump，方便定位供电、看门狗和堆栈问题。
CONFIG_ESP_BROWNOUT_DET=y
CONFIG_ESP_BROWNOUT_DET_LVL_SEL_7=y
CONFIG_ESP_COREDUMP_ENABLE_TO_FLASH=y

# 首次硬件点亮默认只运行屏幕 QSPI 安全测试，跳过 Wi-Fi/USB 业务流程。
CONFIG_FRIDGE_SCREEN_TEST=y
CONFIG_FRIDGE_SCREEN_TEST_PCLK_HZ=10000000
```
